## bb_hello_editor/conf/bblayers.conf
```bitbake
# Initialize BBPATH with the top-level directory of the
# build environment.
BBPATH := "${TOPDIR}"
# Initialize BBFILES to an empty string as it is set up
# by the layer.conf files of the layers.
BBFILES ?= ""

# Add our layer to BBLAYERS.
BBLAYERS = " \
  /home/shu/yocto/example-yocto/bb_hello_editor/meta-editor \
  "
```

## bb_hello_editor/meta-editor/conf/layer.conf
```bitbake
# Add the path of this layer to BBPATH
BBPATH .= ":${LAYERDIR}"

# Add recipes and append files to BBFILES
BBFILES += "${LAYERDIR}/recipes-*/*/*.bb \
            ${LAYERDIR}/recipes-*/*/*.bbappend"

# Set layer search pattern and priority
BBFILE_COLLECTIONS += "meta-editor"
BBFILE_PATTERN_meta-editor := "^${LAYERDIR}/"
BBFILE_PRIORITY_meta-editor = "5"

# List the layer names it is compatible with.
LAYERDEPENDS_meta-editor = "core"
LAYERSERIES_COMPAT_meta-editor = "kirkstone"
```

## meta-costa-embedded/conf/layer.conf
```bitbake
# We have a conf and classes directory, add to BBPATH
BBPATH .= ":${LAYERDIR}"

# We have recipes-* directories, add to BBFILES
BBFILES += "${LAYERDIR}/recipes-*/*/*.bb \
            ${LAYERDIR}/recipes-*/*/*.bbappend"

BBFILE_COLLECTIONS += "meta-costa-embedded"
BBFILE_PATTERN_meta-costa-embedded = "^${LAYERDIR}/"
BBFILE_PRIORITY_meta-costa-embedded = "6"

LAYERDEPENDS_meta-costa-embedded = "core"
LAYERSERIES_COMPAT_meta-costa-embedded = "kirkstone"
```
